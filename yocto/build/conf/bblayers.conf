## yocto/build/conf/bblayers.conf
```bitbake
# LAYER_CONF_VERSION is increased each time build/conf/bblayers.conf
# changes incompatibly
LCONF_VERSION = "6"

BBPATH = "${TOPDIR}"
BBFILES ?= ""

BBLAYERS ?= " \
  /home/korobochka/yocto/poky/meta \
  /home/korobochka/yocto/poky/meta-yocto \
  /home/korobochka/yocto/poky/meta-yocto-bsp \
  /home/korobochka/yocto/poky/meta-ti \
  /home/korobochka/yocto/poky/meta-beaglesnd \
  "
BBLAYERS_NON_REMOVABLE ?= " \
  /home/korobochka/yocto/poky/meta \
  /home/korobochka/yocto/poky/meta-yocto \
  "
```

## yocto/meta-beaglesnd/conf/layer.conf
```bitbake
# We have a conf and classes directory, append to BBPATH
BBPATH .= ":${LAYERDIR}"

# We have a recipes directory, add to BBFILES
BBFILES += "${LAYERDIR}/recipes*/*/*.bb ${LAYERDIR}/recipes*/*/*.bbappend"

BBFILE_COLLECTIONS += "beaglesnd"
BBFILE_PATTERN_beaglesnd := "^${LAYERDIR}/"
BBFILE_PRIORITY_beaglesnd = "7"

LAYERDEPENDS_beaglesnd = "meta-ti"
```
